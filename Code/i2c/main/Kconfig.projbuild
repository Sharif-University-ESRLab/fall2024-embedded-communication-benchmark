## Code/i2c/main/Kconfig.projbuild
```kconfig
menu "Example Configuration"

    menu "I2C Slave"
        config I2C_SLAVE_SCL
            int "SCL GPIO Num"
            default 4
            help
                GPIO number for I2C Slave clock line.

        config I2C_SLAVE_SDA
            int "SDA GPIO Num"
            default 5
            help
                GPIO number for I2C Slave data line.

        config I2C_SLAVE_ADDRESS
            hex "I2C SLAVE ADDRESS"
            default 0x28
            help
                Address of I2C slave

        config EXAMPLE_TOTAL_COUNT
            int "total number of simulation runs"
            default 10
            range 4 500
            help
                Something

        config EXAMPLE_TASK_STACK_SIZE
            int "stack size for RtOS tasks"
            default 1024
            range 128 4096
            help
                Something

        config EXAMPLE_DEADLINE
            int "simulation deadline in ms"
            default 100
            range 10 1024
            help
                Something

        config EXAMPLE_MASTER_SDA
            int "GPIO number for Master SDA"
            default 21
            range 1 40
            help
                Something

        config EXAMPLE_MASTER_SCL
            int "GPIO number for Master SCL"
            default 22
            range 1 40
            help
                Something

        config EXAMPLE_SLAVE_SDA
            int "GPIO number for Slave SDA"
            default 25
            range 1 40
            help
                Something

        config EXAMPLE_SLAVE_SCL
            int "GPIO number for Slave SCL"
            default 26
            range 1 40
            help
                Something

        config EXAMPLE_DATA_SIZE
            int "Size of transmitted data"
            default 20
            range 1 1024
            help
                Something

    endmenu

endmenu
```

## Code/spi/main/Kconfig.projbuild
```kconfig
menu "Echo Example Configuration"

    orsource "$IDF_PATH/examples/common_components/env_caps/$IDF_TARGET/Kconfig.env_caps"

    config EXAMPLE_TOTAL_COUNT
        int "How many rounds of simulation to run"
        range 1 100000
        default 50
        help
            How many times to run the send/receive round simulation

    config EXAMPLE_DEADLINE
        int "Simulation deadline (ms)"
        range 1 10000
        default 100
        help
            in the simulation RT system, what would be the
            deadline of the read/write task

    config EXAMPLE_MASTER_MOSI
        int "GPIO Pin number for Master's MOSI"
        range 1 40
        default 13
        help
            Something

    config EXAMPLE_MASTER_MISO
        int "GPIO Pin number for Master's MISO"
        range 1 40
        default 12
        help
            Something

    config EXAMPLE_MASTER_CLK
        int "GPIO Pin number for Master's CLK"
        range 1 40
        default 14
        help
            Something

    config EXAMPLE_MASTER_CS
        int "GPIO Pin number for Master's CS"
        range 1 40
        default 15
        help
            Something

    config EXAMPLE_SLAVE_MOSI
        int "GPIO Pin number for Slave's MOSI"
        range 1 40
        default 23
        help
            Something

    config EXAMPLE_SLAVE_MISO
        int "GPIO Pin number for Slave's MISO"
        range 1 40
        default 19
        help
            Something

    config EXAMPLE_SLAVE_CLK
        int "GPIO Pin number for Slave's CLK"
        range 1 40
        default 18
        help
            Something

    config EXAMPLE_SLAVE_CS
        int "GPIO Pin number for Slave's CS"
        range 1 40
        default 5
        help
            Something

    #config EXAMPLE_DATA_SIZE
    #    int "Size of the data being transmitted each round"
    #    range 5 2048
    #    default 512
    #    help
    #        in each round of simulation, a random buffer is
    #        initialized to be transmitted. The parameter
    #        specifies the size of that buffer

    config EXAMPLE_TASK_STACK_SIZE
        int "SPI echo example task stack size"
        range 1024 16384
        default 3072
        help
            Defines stack size for SPI echo example. Insufficient stack size can cause crash.

endmenu
```

## Code/uart/main/Kconfig.projbuild
```kconfig
menu "Echo Example Configuration"

    orsource "$IDF_PATH/examples/common_components/env_caps/$IDF_TARGET/Kconfig.env_caps"

    config EXAMPLE_TOTAL_COUNT
        int "How many rounds of simulation to run"
        range 1 100000
        default 50
        help
            How many times to run the send/receive round simulation

    config EXAMPLE_INTERNAL_SIMUL
        bool "Internal simulation"
        default false
        help
            Should the simulation internally i.e: should the
            simulation use a second UART device as the Infinity
            source.
            If this is false then the infinity source must be 
            produced by a connected UART contriller to the DEVICE

    config EXAMPLE_DEADLINE
        int "Simulation deadline (ms)"
        range 1 10000
        default 100
        help
            in the simulation RT system, what would be the
            deadline of the read/write task

    config EXAMPLE_UART_PORT_NUM_INF
        int "Infinity UART port number"
        range 0 2 if IDF_TARGET_ESP32 || IDF_TARGET_ESP32S3
        default 2 if IDF_TARGET_ESP32 || IDF_TARGET_ESP32S3
        range 0 1
        default 1
        help
            UART communication port number for the example.
            See UART documentation for available port numbers.

    config EXAMPLE_UART_PORT_NUM_DEV
        int "Device UART port number"
        range 0 2 if IDF_TARGET_ESP32 || IDF_TARGET_ESP32S3
        default 2 if IDF_TARGET_ESP32 || IDF_TARGET_ESP32S3
        range 0 1
        default 1
        help
            UART communication port number for the example.
            See UART documentation for available port numbers.

    config EXAMPLE_UART_BAUD_RATE
        int "UART communication speed"
        range 1200 115200
        default 115200
        help
            UART communication speed for Modbus example.

    config EXAMPLE_UART_RXD_INF
        int "Infinite UART RXD pin number"
        range ENV_GPIO_RANGE_MIN ENV_GPIO_IN_RANGE_MAX
        default 5
        help
            GPIO number for UART RX pin. See UART documentation for more information
            about available pin numbers for UART.

    config EXAMPLE_UART_TXD_INF
        int "Infinite UART TXD pin number"
        range ENV_GPIO_RANGE_MIN ENV_GPIO_OUT_RANGE_MAX
        default 4
        help
            GPIO number for UART TX pin. See UART documentation for more information
            about available pin numbers for UART.

    config EXAMPLE_UART_RXD_DEV
        int "Device UART RXD pin number"
        range ENV_GPIO_RANGE_MIN ENV_GPIO_IN_RANGE_MAX
        default 5
        help
            GPIO number for UART RX pin. See UART documentation for more information
            about available pin numbers for UART.

    config EXAMPLE_UART_TXD_DEV
        int "Device UART TXD pin number"
        range ENV_GPIO_RANGE_MIN ENV_GPIO_OUT_RANGE_MAX
        default 4
        help
            GPIO number for UART TX pin. See UART documentation for more information
            about available pin numbers for UART.

    config EXAMPLE_TASK_STACK_SIZE
        int "UART echo example task stack size"
        range 1024 16384
        default 3072
        help
            Defines stack size for UART echo example. Insufficient stack size can cause crash.

endmenu
```
